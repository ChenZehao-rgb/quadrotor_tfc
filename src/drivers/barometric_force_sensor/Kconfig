## src/drivers/barometric_force_sensor/Kconfig
```kconfig
menuconfig DRIVERS_BAROMETRIC_FORCE_SENSOR
	bool "barometric_force_sensor"
	default n
	---help---
		Enable support for barometric_force_sensor
```

## src/drivers/barometricforce/Kconfig
```kconfig
menuconfig DRIVERS_BAROMETRICFORCE
	bool "barometricforce"
	default n
	---help---
		Enable support for barometricforce
```

## src/examples/forcectl/Kconfig
```kconfig
menuconfig EXAMPLES_FORCECTL
	bool "forcectl"
	default n
	---help---
		Enable support for forcectl
```

## src/examples/forcectl_app/Kconfig
```kconfig
menuconfig EXAMPLES_FORCECTL_APP
	bool "forcectl_app"
	default n
	---help---
		Enable support for forcectl_app
```

## src/examples/hellow_sky/Kconfig
```kconfig
menuconfig EXAMPLES_HELLOW_SKY
 bool "hellow_sky"
 default n
 ---help---
     Enable support for hellow_sky
```

## src/modules/mc_robust_control/Kconfig
```kconfig
menuconfig MODULES_MC_ROBUST_CONTROL
	bool "mc_robust_control"
	default n
	---help---
		Enable support for mc_robust_control
```

## src/modules/thrust_feedback_control/Kconfig
```kconfig
menuconfig MODULES_THRUST_FEEDBACK_CONTROL
	bool "thrust_feedback_control"
	default n
	---help---
		Enable support for thrust_feedback_control
```
